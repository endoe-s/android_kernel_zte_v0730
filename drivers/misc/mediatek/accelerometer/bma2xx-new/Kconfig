## drivers/misc/mediatek/accelerometer/bma2xx-new/Kconfig
```kconfig
config MTK_BMA254
        bool "BMA2xx-NEW for MediaTek package"
        default n
```

## drivers/misc/mediatek/accelerometer/lis2ds12/Kconfig
```kconfig
config MTK_LIS2DS12
	bool "ST LIS2DS12 for MediaTek package"
	default n
	help
	  It support different accelerometer sensor.
          If this option is set,
	  it will support
          LIS2DS12 Accelerometer.
```

## drivers/misc/mediatek/accelerometer/lsm6ds3a/Kconfig
```kconfig
config MTK_LSM6DS3
	bool "ST LSM6DS3 for MediaTek package"
	default n
	help
	  It support different accelerometer sensor.
          If this option is set,
	  it will support
          LSM6DS3 Accelerometer.
```

## drivers/misc/mediatek/accelerometer/n2dm/Kconfig
```kconfig
config MTK_N2DM
	bool "STMicroelectronics N2DM accelerometer for MediaTek package"
	default n
	help
	  It support different accelerometer sensor.
          If this option is set,
	  it will support
          N2DM Accelerometer.
```

## drivers/misc/mediatek/flashlight/Kconfig
```kconfig
config MTK_FLASHLIGHT
  bool CONFIG_MTK_FLASHLIGHT
  default n
  help
    CONFIG_MTK_FLASHLIGHT

config CUSTOM_KERNEL_FLASHLIGHT
        string "CUSTOM_KERNEL_FLASHLIGHT"
        help
          Kernel space cameara flashlight driver. You can use this driver
          choose cameara flashlight type.


config P650A31_FLASHLIHGT_LM3646
        string "P650A31_FLASHLIHGT_LM3646"
        help
          Kernel space cameara flashlight driver. You can use this driver
          choose cameara flashlight type.
```

## drivers/misc/mediatek/hall/Kconfig
```kconfig
config CUSTOM_KERNEL_HALL
	bool "CUSTOM_KERNEL_HALL"
	help
	  hall sensor to detect accelerometer from off/on.
          If the platform is supported for hall, this
          configuration should be configured, and the hall
          driver configuration should be configured as well.
```

## drivers/spi/mediatek/Kconfig
```kconfig
#SPI
config MTK_SPI
	tristate "MediaTek SPI controller"
	#depends on SPI
	default n
	---help---
	This selects the MediaTek(R) SPI bus driver.
	If you want to use MediaTek(R) SPI interface, say Y or M here.  If unsure, say N.

config FINGERPRINT_SUPPORT
	bool "fingerprint"
	default n
	---help---
	Select this option to support fingerprint core.
		
config FINGERPRINT_GF3208_REE
	bool "gf3208(goodix fingerprint sensor)  for dewav"
	depends on INPUT && FINGERPRINT_SUPPORT
	default n
	help
	It support different type sensor
	in this platform. If this option
	is set, it will support fingerprint gf3208 silead sensor .

config MICROARRAY_FINGERPRINT
	tristate "microarray Fingerprint"
	depends on INPUT && FINGERPRINT_SUPPORT
	default n
	---help---
	microarray Fingerprint chip afs121n support
	
config LEADCORE_FINGERPRINT
	tristate "LeadCore Fingerprint"
	depends on INPUT && FINGERPRINT_SUPPORT
	default n
	---help---
	LeadCore fingerprint sensor lc1550 support
	
config CHIPSAILING_FINGERPRINT
	tristate "ChipSailing Fingerprint"
	depends on INPUT && FINGERPRINT_SUPPORT
	default n
	---help---
	ChipSailing fingerprint sensor support

config SUNWAVE_FINGERPRINT
	tristate "sunwave Fingerprint"
	depends on INPUT && FINGERPRINT_SUPPORT
	default n
	---help---
	sunwave fingerprint sensor support
	
```
